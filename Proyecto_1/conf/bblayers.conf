## Proyecto_1/conf/bblayers.conf
```bitbake
# POKY_BBLAYERS_CONF_VERSION is increased each time build/conf/bblayers.conf
# changes incompatibly
POKY_BBLAYERS_CONF_VERSION = "2"

BBPATH = "${TOPDIR}"
BBFILES ?= ""

BBLAYERS ?= " \
  /home/eduardo/Yocto/poky-warrior/meta \
  /home/eduardo/Yocto/poky-warrior/meta-poky \
  /home/eduardo/Yocto/poky-warrior/meta-yocto-bsp \
  /home/eduardo/Yocto/poky-warrior/meta-openembedded/meta-oe \
  /home/eduardo/Yocto/poky-warrior/meta-openembedded/meta-python \
  /home/eduardo/Yocto/poky-warrior/meta-contornos \
  /home/eduardo/Yocto/poky-warrior/meta-hellocpp \
  /home/eduardo/Yocto/poky-warrior/meta-bordes \
  "
```

## Proyecto_1/meta-bordes/conf/layer.conf
```bitbake
# We have a conf and classes directory, add to BBPATH
BBPATH .= ":${LAYERDIR}"

# We have recipes-* directories, add to BBFILES
BBFILES += "${LAYERDIR}/recipes-*/*.bb \
        	${LAYERDIR}/recipes-*/*/*.bbappend"

BBFILE_COLLECTIONS += "bordes"
BBFILE_PATTERN_bordes = "^${LAYERDIR}/"
BBFILE_PRIORITY_bordes = "5"
LAYERVERSION_bordes = "4"
LAYERSERIES_COMPAT_bordes = " "
```

## Proyecto_1/meta-contornos/conf/layer.conf
```bitbake
# We have a conf and classes directory, add to BBPATH
BBPATH .= ":${LAYERDIR}"

# We have recipes-* directories, add to BBFILES
BBFILES += "${LAYERDIR}/recipes-*/*.bb \
        	${LAYERDIR}/recipes-*/*/*.bbappend"

BBFILE_COLLECTIONS += "contornos"
BBFILE_PATTERN_contornos = "^${LAYERDIR}/"
BBFILE_PRIORITY_contornos = "5"
LAYERVERSION_contornos = "4"
LAYERSERIES_COMPAT_face = " "
```
